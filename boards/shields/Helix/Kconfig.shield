## boards/shields/Helix/Kconfig.shield
```kconfig
# Copyright (c) 2020 Pete Johanson
# SPDX-License-Identifier: MIT

config SHIELD_HELIX_LEFT
	def_bool $(shields_list_contains,Helix_left)

config SHIELD_HELIX_RIGHT
	def_bool $(shields_list_contains,Helix_right)
```

## boards/shields/Helix_dongle/Kconfig.shield
```kconfig
# Copyright (c) 2020 The ZMK Contributors
# SPDX-License-Identifier: MIT

config SHIELD_HELIX_DONGLE_CENTRAL
    def_bool $(shields_list_contains,Helix_dongle_central)

config SHIELD_HELIX_DONGLE_LEFT
    def_bool $(shields_list_contains,Helix_dongle_left)

config SHIELD_HELIX_DONGLE_RIGHT
    def_bool $(shields_list_contains,Helix_dongle_right)
```

## boards/shields/Nice_view_adapter/Kconfig.shield
```kconfig
config SHIELD_NICE_VIEW_ADAPTER
    def_bool $(shields_list_contains,Nice_view_adapter)
```
